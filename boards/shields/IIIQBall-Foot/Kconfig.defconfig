## boards/shields/IIIQBall-Foot/Kconfig.defconfig
```kconfig
# --- Foot（親機 / Central / Dongle代わり）の設定 ---
if SHIELD_IIIQBALL-FOOT_F

config ZMK_KEYBOARD_NAME
    default "IIIQBALL-FOOT_F"

config ZMK_SPLIT
    default y

config ZMK_SPLIT_ROLE_CENTRAL
    default y

# 子機の数（LとRの2つ）に合わせて2に設定
config ZMK_SPLIT_BLE_CENTRAL_PERIPHERALS
    default 2

# 子機(2) + 接続先BTプロファイル(通常5) = 7
config BT_MAX_CONN
    default 7

config BT_MAX_PAIRED
    default 7

endif


# --- 左手側（子機 / Peripheral）の設定 ---
if SHIELD_IIIQBALL-FOOT_L

config ZMK_KEYBOARD_NAME
    default "IIIQBALL-FOOT_L"

config ZMK_SPLIT
    default y

endif


# --- 右手側（子機 / Peripheral）の設定 ---
if SHIELD_IIIQBALL-FOOT_L

config ZMK_KEYBOARD_NAME
    default "IIIQBALL-FOOT_R"

config ZMK_SPLIT
    default y

endif
```

## boards/shields/IIIQBall-Foot/Kconfig.shield
```kconfig
config SHIELD_IIIQBALL-FOOT_F

def_bool $(shields_list_contains,IIIQBall-Foot_f)



config SHIELD_IIIQBALL-FOOT_R

def_bool $(shields_list_contains,IIIQBall-Foot_r)



config SHIELD_IIIQBALL-FOOT_L

def_bool $(shields_list_contains,IIIQBall-Foot_l)
```

## boards/shields/IIIQBall_Foot/Kconfig.shield
```kconfig
config SHIELD_IIIQBall_FOOT_F

def_bool $(shields_list_contains,IIIQBall_Foot_f)

config SHIELD_IIIQBall_FOOT_R

def_bool $(shields_list_contains,IIIQBall_Foot_r)

config SHIELD_IIIQBall_FOOT_L

def_bool $(shields_list_contains,IIIQBall_Foot_l)
```

## config/west.yml
```yaml
manifest:
  remotes:
    - name: zmkfirmware
      url-base: https://github.com/zmkfirmware
    - name: KATATHY-ZMK
      url-base: https://github.com/KATACY-ZMK
    - name: prospector
      url-base: https://github.com/t-ogura
    - name: badjeff
      url-base: https://github.com/badjeff


  projects:
    - name: zmk
      remote: zmkfirmware
      revision: main
      import: app/west.yml
    - name: prospector-zmk-module
      remote: prospector
      revision: v2.1.0  # Use v2.0.0 for ZMK ≤0.3 (Zephyr 3.x)
      path: modules/prospector-zmk-module
    - name: zmk-pmw3610-driver
      remote: badjeff
      revision: main

  self:
    path: config
```
